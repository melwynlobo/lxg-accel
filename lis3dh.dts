/*
 * Copyright (C) 2017 LXGroup
 *
 * Author: Melwyn Lobo
 * This program is free software; you can redistribute it and/or modify
 * it under the terms of the GNU General Public License version 2 as
 * published by the Free Software Foundation.
 */
/dts-v1/;
/plugin/;

/ {
	compatible = "ti,beaglebone", "ti,beaglebone-black";

	part-number = "lis3dh";
	version = "00A0";

	exclusive-use =
		/* the pin header uses */
		"P9.1",		/* DGND */
		"P9.3",		/* VD_3V3 */
		"P9.15",	/* GPIO_48 */
		"P9.19",	/* i2c1_scl */
		"P9.20",	/* i2c1_sda */
		/* the hardware ip uses */
		"i2c2";

	fragment@0 {
		target = <&i2c2>;

		__overlay__ {
			status = "okay";
			pinctrl-names = "default";
			pinctrl-0 = <>;

			#address-cells = <1>;
			#size-cells = <0>;
			lis3dh@18 {
				compatible = "st,BBLIS3DH";
				reg = <0x18>;
			};
		};
	};
};
